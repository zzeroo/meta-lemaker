## conf/bblayers.conf.sample
```bitbake
# POKY_BBLAYERS_CONF_VERSION is increased each time build/conf/bblayers.conf
# changes incompatibly
POKY_BBLAYERS_CONF_VERSION = "2"

BBPATH = "${TOPDIR}"
BBFILES ?= ""

BBLAYERS ?= " \
  /home/smueller/src/poky/meta \
  /home/smueller/src/poky/meta-poky \
  /home/smueller/src/poky/meta-yocto-bsp \
  /home/smueller/src/poky/meta-openembedded/meta-oe \
  /home/smueller/src/poky/meta-clang \
  /home/smueller/src/poky/meta-lemaker \
  /home/smueller/src/poky/meta-ra-gas \
  /home/smueller/src/poky/meta-rust-bin \
"

#/home/smueller/src/poky/meta-clang \
# /home/smueller/src/poky/meta-openembedded/meta-oe => fonts gnome

# git://git.yoctoproject.org/poky
# meta-poky         = "git://git.yoctoproject.org/poky master
# meta-yocto-bsp    = "git://git.yoctoproject.org/poky
# meta-oe           = "git://git.openembedded.org/meta-openembedded master
# meta-lemaker      = "master:cdddf08a64f34d9bce9b51093ed31bdc116debc7"
# meta-ra-gas       = "master:b0ac687c9aaff24c59c2e16c299ac829db34257f"
# meta-rust-bin     = "nightly:f84858a6696d38b2b7c4855016d0f8865766ffff"
```

## conf/layer.conf
```bitbake
# We have a conf and classes directory, add to BBPATH
BBPATH .= ":${LAYERDIR}"

# We have recipes-* directories, add to BBFILES
BBFILES += "${LAYERDIR}/recipes-*/*/*.bb \
						${LAYERDIR}/recipes-*/*/*.bbappend"

BBFILE_COLLECTIONS += "lemaker"
BBFILE_PATTERN_lemaker = "^${LAYERDIR}/"
BBFILE_PRIORITY_lemaker = "5"
```

## conf/machine/bananapro.conf
```bitbake
#@TYPE: Machine
#@NAME: BananaPro machine
#@DESCRIPTION: Machine configuration for Lemaker BananaPro http://www.lemaker.org/product-bananapro-resource.html boards

include conf/machine/include/bananapro-base.inc
include conf/machine/include/tune-cortexa7.inc

COMPATIBLE_MACHINE_bananapro = "bananapro"
# DEFAULTTUNE ?= "cortexa7hf"
DEFAULTTUNE = "cortexa7hf-neon-vfpv4"
EXTRA_IMAGECMD_jffs2 = "-lnp "
EXTRA_IMAGEDEPENDS += "u-boot"
IMAGE_BOOT_FILES ?= "u-boot.${UBOOT_SUFFIX}"
IMAGE_FSTYPES += "tar.bz2 sdcard"

KERNEL_DEVICETREE = "sun7i-a20-bananapro.dtb"
KERNEL_EXTRA_ARGS += "LOADADDR=${UBOOT_ENTRYPOINT}"
KERNEL_IMAGETYPE = "uImage"

MACHINE_EXTRA_RRECOMMENDS = " kernel-modules kernel-devicetree"
#MACHINE_EXTRA_RRECOMMENDS += "linux-firmware-bcm4354"
MACHINE_FEATURES = "usbgadget usbhost vfat alsa"
# PREFERRED_PROVIDER_virtual/kernel ?= "linux-yocto"
# PREFERRED_VERSION_linux-yocto ?= "4.8%"
PREFERRED_PROVIDER_virtual/kernel ?= "linux-yocto-bananapro"
PREFERRED_VERSION_linux-yocto-banananpro ?= "4.6%"

SERIAL_CONSOLE = "115200 ttyS0"
SPL_BINARY="u-boot-sunxi-with-spl.bin"
UBOOT_ENTRYPOINT = "0x40008000"
UBOOT_LOADADDRESS = "0x40008000"
UBOOT_ENV ?= ""
UBOOT_ENV_SUFFIX ?= "scr"
UBOOT_MACHINE = "Bananapro_config"
UBOOT_SUFFIX = "img"
# http://www.yoctoproject.org/docs/2.2/mega-manual/mega-manual.html#devtmpfs-dev-management
VIRTUAL-RUNTIME_dev_manager = "udev"
```

## conf/machine/include/bananapro-base.inc
```bitbake
IMAGE_BOOT_FILES ?= "${KERNEL_IMAGETYPE};${SDIMG_KERNELIMAGE}"
IMAGE_CLASSES += "sdcard_image-bpro"
```

## scripts/lib/image/canned-wks/sdimage-bananapro.wks
```
# short-description: Create BananaPro SD card image
# long-description: Creates a partitioned SD card image for use with
# BananaPro Boot files are located in the first vfat partition.

part /boot --source bootimg-partition --ondisk mmcblk --fstype=vfat --label boot --active --align 4096 --size 20
part / --source rootfs --ondisk mmcblk --fstype=ext4 --label root --align 4096
```
